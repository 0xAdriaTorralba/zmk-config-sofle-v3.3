## boards/shields/nice_view_sofle/Kconfig.shield
```kconfig
config SHIELD_NICE_VIEW_SOFLE
    def_bool $(shields_list_contains,nice_view_sofle)
```

## config/west.yml
```yaml
manifest:
  remotes:
    - name: zmkfirmware
      url-base: https://github.com/zmkfirmware
      # Additional modules containing boards/shields/custom code can be listed here as well.
      # See:
      # - https://zmk.dev/docs/features/modules
      # - https://docs.zephyrproject.org/3.5.0/develop/west/manifest.html#projects
    - name: m165437
      url-base: https://github.com/M165437
  #  - name: gpeye
  #    url-base: https://github.com/GPeye
  projects:
   # - name: mario-peripheral-animation
   #   remote: gpeye
   #    revision: main 
    - name: eyelash_sofle
      url: https://github.com/a741725193/zmk-sofle
      # pinned to upstream main as of 2026-07-23 (cad1477)
      revision: cad147725279b0635a3d512ac99f6668bfec3704
    - name: zmk
      remote: zmkfirmware
      revision: v0.3.0
      import: app/west.yml
    - name: nice-view-gem
      remote: m165437
      revision: v0.3.0
  self:
    path: boards
```
